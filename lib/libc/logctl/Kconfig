## os/drivers/syslog/Kconfig
```kconfig
#
# For a description of the syntax of this configuration file,
# see kconfig-language at https://www.kernel.org/doc/Documentation/kbuild/kconfig-language.txt
#

comment "System Logging"

config SYSLOG_CHAR
	bool "Log to a character device"
	default y if SYSLOG
	depends on SYSLOG
	---help---
		Enable the generic character device for the SYSLOG. The full path to the
		SYSLOG device is provided by SYSLOG_DEVPATH. A valid character device (or
		file) must exist at this path. It will be opened by syslog_initialize.

config SYSLOG_DEVPATH
	string "System log device"
	default "/dev/console"
	depends on SYSLOG_CHAR
	---help---
		The full path to the system logging device. For character SYSLOG devices,
		it should be some existing character device (or file) supported by the
		configuration (such as "/dev/console" or "/dev/ttyS1").

config RAMLOG
	bool "RAM log device support"
	default n
	---help---
		This is a driver that was intended to support debugging output,
		aka syslogging, when the normal serial output is not available.
		For example, if you are using a telnet or USB serial console,
		the debug output will get lost.  However, the RAMLOG device should
		be usable even if system logging is disabled.

		This driver is similar to a pipe in that it saves the debugging
		output in a FIFO in RAM.  It differs from a pipe in numerous
		details as needed to support logging.

if RAMLOG
config RAMLOG_SYSLOG
	bool "Use RAMLOG for SYSLOG"
	default n
	depends on SYSLOG
	---help---
		Use the RAM logging device for the syslogging interface.  If this feature
		is enabled (along with SYSLOG), then all debug output (only) will be re-directed
		to the circular buffer in RAM.  This RAM log can be view from TASH using the
		'dmesg'command.

		Do not enable more than one SYSLOG device.

config RAMLOG_CONSOLE
	bool "Use RAMLOG for /dev/console"
	default n
	depends on DEV_CONSOLE
	---help---
		Use the RAM logging device as a system console. If this feature is enabled (along
		with DEV_CONSOLE), then all console output will be re-directed to a circular
		buffer in RAM.  This is useful, for example, if the only console is a Telnet
		console.  Then in that case, console output from non-Telnet threads will go to
		the circular buffer and can be viewed using the TASH 'dmesg' command.

config RAMLOG_BUFSIZE
	int "RAMLOG buffer size"
	default 1024
	depends on RAMLOG_SYSLOG || RAMLOG_CONSOLE
	---help---
		Size of the console RAM log.  Default: 1024

config RAMLOG_UPDATE_LATEST
	bool "RAMLOG buffer updates(overwrite)"
	default y
	depends on RAMLOG_SYSLOG || RAMLOG_CONSOLE
	---help---
		Updates the latest contents of circular buffer if write overflow occurs. 

config RAMLOG_CRLF
	bool "RAMLOG CR/LF"
	default n
	---help---
		Pre-pend a carriage return before every linefeed that goes into the RAM log.

config RAMLOG_NONBLOCKING
	bool "RAMLOG non-block reads"
	default y
	---help---
		Reading from the RAMLOG will never block if the RAMLOG is empty.  If the RAMLOG
		is empty, then zero is returned (usually interpreted as end-of-file).

config RAMLOG_NPOLLWAITERS
	int "RAMLOG number of poll waiters"
	default 4
	depends on !DISABLE_POLL
	---help---
		The maximum number of threads that may be waiting on the poll method.

endif

config SYSLOG_CONSOLE
	bool "Use SYSLOG for /dev/console"
	default n
	depends on DEV_CONSOLE
	---help---
		Use the syslog logging device as a system console. If this feature is enabled 
		(along with DEV_CONSOLE), then all console output will be re-directed to syslog
		output (syslog_putc). This is useful, for example, if the only console is a Telnet
		console.  Then in that case, console output from non-Telnet threads will go to
		the syslog output.

menuconfig SYSLOG_FILE
	bool "Syslog file output"
	default n
	depends on SYSLOG
	select SYSLOG_CHAR
	---help---
		Build in support to use a file to collect SYSLOG output.  File SYSLOG
		channels differ from other SYSLOG channels in that they cannot be
		established until after fully booting and mounting the target file
		system.  The function syslog_file_channel() would need to be called
		from board-specific bring-up logic AFTER mounting the file system
		containing 'devpath'.

		NOTE: This option automatically enables SYSLOG_CHAR which provides
		the underlying character device driver support needed for file-based
		logging. Interrupt level SYSLOG output will be lost in this case unless
		the interrupt buffer is used.

if SYSLOG_FILE

config SYSLOG_FILE_SEPARATE
	bool "Log file separation"
	default n
	---help---
		If enabled, every time the file logger is re-attached, a separator
		will be printed in the file.

		This can be useful to easily distinguish between log entries that
		belong to different log sessions (e.g. system reboot), and to
		indicate that between the separated lines there may be more logs
		that were lost.

config SYSLOG_FILE_ROTATIONS
	int "Log file rotations"
	default 0
	---help---
		If enabled (set to a non-zero number), the log file size will be
		checked before opening. If it is larger than the specified limit
		it will be "rotated", i.e. the old file will be kept as a backup,
		and a new empty	file will be created.

		The number of rotations specifies the number of old log files to
		keep.

		This option is useful to ensure that log files do not get
		huge after prolonged periods of system operation.

config SYSLOG_FILE_SIZE_LIMIT
	int "Log file size limit"
	default 524288
	depends on SYSLOG_FILE_ROTATIONS > 0
	---help---
		File size limit when the log is rotated automatically.
		If a log file is found larger than this limit, it will
		be rotated.

endif # SYSLOG_FILE
```

## os/mm/kasan/Kconfig
```kconfig
config MM_KASAN_REGIONS
	int "Number of KASAN regions"
	default 8
	---help---
		Maximum number of memory regions that can be registered with KASAN.
		Registration of a region beyond this limit is refused with a
		message and that region is left unchecked.

config MM_KASAN_DISABLE_AT_BOOT
	bool "Disable KASAN at boot time"
	default y
	---help---
		When enabled, KASAN checking is disabled at boot time. This allows
		the system to boot without KASAN detecting issues during initialization.

		KASAN can be enabled later through a kasan command when you want to
		start checking for memory errors. This is useful for:
		- Avoiding false positives during boot
		- Enabling KASAN only when running specific tests
		- Production builds where boot-time checking is not needed

		If disabled (n), KASAN starts checking immediately after the kernel
		heap is registered during boot.

		For now, keep this enabled (y) and use the kasan command to enable
		checking when needed.

config MM_KASAN_SELFTEST
	bool "Self test"
	default n
	---help---
		Build kernel/debug/kasan_selftest.c, which performs one deliberate
		memory error against the kernel heap on request, and the
		kasan_test application which drives it.

		A system with no memory errors and a system where instrumentation
		was never emitted are both silent, so a clean boot on its own says
		nothing about whether KASan is working. This is what tells them
		apart. Enable it for bring up and for a CI job, and turn it off
		once the port is trusted on a board.

		Every case but the in bounds one is expected to report and to
		assert. That is the pass condition. Do not enable this on a
		product image.

		Requires BUILTIN_APPS so the application registers as a TASH
		command.

config MM_KASAN_START_MANUAL
	bool "Leave checking off until it is asked for"
	default n
	---help---
		Register the regions and maintain the shadow map as usual, but do
		not begin reporting until something calls kasan_start().

		Without this, checking goes live the moment the first heap
		registers, which is very early in os_start(). The whole of boot
		then runs instrumented: drivers, Wi-Fi, the filesystem and the
		binary manager. That is what you want eventually, but it is not
		where to begin, because a report from any of them stops the board
		before it reaches a prompt.

		With this set the board boots silently and you arm KASan when you
		are ready, so a report can only come from the code you are
		testing.

		The shadow map is still maintained while disarmed. Every
		allocation and free keeps it accurate, so when you do arm, blocks
		handed out during boot are tracked correctly and a later use
		after free of one of them is still caught.

		What is lost is anything that went wrong while disarmed: KASan
		reports at the moment of access, never retroactively. Once your
		own tests are clean, boot once with this off, because the boot
		path is where driver and vendor bugs surface.

		The kasan_test application arms and disarms it from the shell.

config MM_KASAN_DISABLE_NULL_POINTER_CHECK
	bool "Do not check for NULL pointer access"
	default n
	---help---
		When enabled, KASAN will not check for NULL pointer accesses.

config MM_KASAN
	bool "KASAN support"
	default y
	---help---
		Enable Kernel Address Sanitizer (KASAN) support for detecting
		memory errors such as out-of-bounds accesses and use-after-free.

config MM_KASAN_INSTRUMENT
	bool "Instrument code for KASAN"
	default y
	depends on MM_KASAN
	---help---
		Enable instrumentation of code for KASAN. This adds checks to
		memory accesses to detect errors.

config MM_KASAN_GENERIC
	bool "Generic KASAN mode"
	default y
	depends on MM_KASAN
	---help---
		Enable generic KASAN mode which uses a shadow memory region to
		track memory accesses.

config MM_KASAN_INSTRUMENT_ALL
	bool "Instrument all code for KASAN"
	default y
	depends on MM_KASAN_INSTRUMENT
	---help---
		Instrument all code including kernel internals. Without this,
		only application code is instrumented.

config MM_KASAN_DISABLE_READS_CHECK
	bool "Disable checking of read accesses"
	default y
	depends on MM_KASAN_INSTRUMENT
	---help---
		When enabled, KASAN will only check write accesses, not reads.
		This reduces overhead but may miss some memory errors.
```
